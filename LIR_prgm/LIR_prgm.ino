/*****************************************************************************************************
  Weapon program - Laser game program for weapon

  Hugues Kadi - ATTSSystem - All rights reserved ©

  Schematics
                                    _______________
                        TX 31       |             |   VIN
                        RX 30       |             |   GND --- GND IR & nRF24 & Screen
                        RST 29      |             |   RST 29
                        GND         |             |   5V --- VCC IR + Laser (220 Ohm)
              Rx IR --- D2 32       |             |   A7 22
              Tx IR --- D3 1        |             |   A6 19
           CE nRF24 --- D4 2        |   Arduino   |   SCL 28 --- SCL Screen
          CSN nRF24 --- D5 9        |    Nano     |   SDA 27 --- SDA Screen
              Piezo --- D6 10       |     V3      |   A3 26
                        D7 11       |             |   A2 25
                        D8 12       |     Old     |   A1 24
     Trigger button --- D9 13       |  Bootloader |   A0 23
                        D10 14      |             |   AREF 21
         MOSI nRF24 --- D11 15      |             |   3V3 --- VCC nRF24 & Screen
         MISO nRF24 --- D12 16      |             |   SCK 17 -- SCK nRF24
                                    _______________

*****************************************************************************************************/

// Screen requirements

#include <Wire.h>
#include <Adafruit_SSD1306.h>
#include <Adafruit_GFX.h>
#define OLED_RESET 4
Adafruit_SSD1306 display(OLED_RESET);
const unsigned char logo [] PROGMEM = {
  // '2700165_4275d', 128x32px
  0x00, 0x00, 0x00, 0x00, 0x00, 0x00, 0x00, 0x00, 0x00, 0x00, 0x00, 0x00, 0x00, 0x00, 0x00, 0x00,
  0x00, 0x00, 0x00, 0x00, 0x00, 0x3f, 0xff, 0xff, 0xff, 0xff, 0xff, 0xe0, 0x00, 0x00, 0x00, 0x00,
  0x00, 0x00, 0x00, 0x00, 0x00, 0x7f, 0xff, 0xff, 0xff, 0xff, 0xff, 0xf8, 0x00, 0x00, 0x00, 0x00,
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  0x00, 0x00, 0x00, 0x00, 0x00, 0x00, 0x00, 0x00, 0x00, 0x00, 0x00, 0x00, 0x00, 0x00, 0x00, 0x00,
};
const unsigned char crossed [] PROGMEM = {
  // 'crâne-3', 128x32px
  0x00, 0x00, 0x00, 0x00, 0x00, 0x00, 0x00, 0x00, 0x00, 0x00, 0x00, 0x00, 0x00, 0x00, 0x00, 0x00,
  0x00, 0x00, 0x00, 0x00, 0x00, 0x00, 0x00, 0x00, 0x00, 0x00, 0x00, 0x00, 0x00, 0x00, 0x00, 0x00,
  0x00, 0x00, 0x00, 0x00, 0x00, 0x00, 0x00, 0x80, 0x01, 0x00, 0x00, 0x00, 0x00, 0x00, 0x00, 0x00,
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  0x00, 0x00, 0x00, 0x00, 0x00, 0x00, 0x00, 0x00, 0x00, 0x00, 0x00, 0x00, 0x00, 0x00, 0x00, 0x00,
};

const unsigned char ticked [] PROGMEM = {
  // 'tick', 128x32px
  0x00, 0x00, 0x00, 0x00, 0x00, 0x00, 0x00, 0x00, 0x00, 0x00, 0x00, 0x00, 0x00, 0x00, 0x00, 0x00,
  0x00, 0x00, 0x00, 0x00, 0x00, 0x00, 0x00, 0x00, 0x00, 0x08, 0x00, 0x00, 0x00, 0x00, 0x00, 0x00,
  0x00, 0x00, 0x00, 0x00, 0x00, 0x00, 0x00, 0x00, 0x00, 0x30, 0x00, 0x00, 0x00, 0x00, 0x00, 0x00,
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  0x00, 0x00, 0x00, 0x00, 0x00, 0x00, 0x00, 0x00, 0x00, 0x00, 0x00, 0x00, 0x00, 0x00, 0x00, 0x00,
};

// nRF24 & Mirf requirements

#include <SPI.h>
#include <nRF24L01.h>
#include <RF24.h>
RF24 radio(4, 5);
const byte addresses[][6] = {"00001", "00002", "00003", "00004", "00005", "00006"};

// Generic requirements

#include <EEPROM.h>
#include <ArduinoSort.h>
#define piezo 9
#define trigger 7

// Vars initialisation

//int firstStart;
//int reset;
unsigned long gamePlay;
int data;
bool playing = true;
bool c = false;
bool c1 = false;
bool c2 = false;
bool c3 = false;
int ID;
int addR = ID - 1;
int channel;
int addT;
byte weaponNb;
byte gameTime;
byte scorePlus;
byte scoreMinus;
int weaponNbDef = 0;
int gameTimeDef = 1;
int scorePlusDef = 2;
int scoreMinusDef = 3;
int receivedID;
int score = 0;
unsigned long timeStart;
unsigned long timeVal;
int delayTime;

// IR Requirements

// Sound Requirements

int speakerPin = piezo;

char notes[] = "gabygabyxzCDxzCDabywabywzCDEzCDEbywFCDEqywFGDEqi        azbC"; // a space represents a rest
int length = sizeof(notes); // the number of notes
int beats[] = { 1, 1, 1, 1, 1, 1, 1, 1, 1, 1, 1, 1, 1,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 16,};
int tempo = 75;

byte dataBytes[5] = {0xA1, 0xF1, ID, 0xAA, 0xAA};

// Setup code

void setup() {

  EEPROM.get(4, ID);
  
  // Screen configuration

  display.begin(SSD1306_SWITCHCAPVCC, 0x3C); // I2C screen address
  display.clearDisplay();
  display.setTextSize(3);
  display.setTextColor(WHITE);
  display.setCursor(0, 0);
  display.clearDisplay();
  display.drawBitmap(0, 0, logo, 128, 32, WHITE);
  display.display();
  delay(3000);
  display.setTextSize(2);
  display.setCursor(0, 0);

  c3 = askUI("Modifier", "ID ou Freq?", 2500, c3);
  if (c3 == true) {
  
    // ID configuration
  
    ID = confUI(1, ID, "ID arme", "", false, ID);
    int addR = ID - 1;
  
    // Freq confiration
  
    channel = confUI(1, ID, "Freq arme", "", false, channel);

  }
  
  // nRF24 configuration

  radio.begin();
  radio.setChannel(channel);
  radio.openReadingPipe(1, addresses[addR]);
  radio.setPALevel(RF24_PA_MIN);
  radio.startListening();

  // IR Rx-Tx configuration

  Serial.begin(9600);

  // Generic configuration (Inputs-Outputs)

  pinMode(trigger, INPUT_PULLUP );
  pinMode(piezo, OUTPUT);
}

// Loop code

void loop() {
  configuration();
  play();
  returnStart();
  ending();
}

void play() {
  display.setTextSize(4);
  timeStart = millis();
  gamePlay = gameTime * 60000;

  // Playing during the game time

  while (timeVal < 60000) {
    //Serial.println(timeVal);
    timeVal = millis() - timeStart;
    updateDisplay();

    // If bullet received

    if (Serial.available()) {
      receivedID = Serial.read();
      if (receivedID != ID && receivedID <= weaponNb+1) {
        data = 44;
        addT = receivedID - 1;
        radio.openWritingPipe(addresses[addT]);
        radio.stopListening();
        radio.write(&data, sizeof(data));
        delay(100);
        radio.startListening();
        score = score - scoreMinus;
        cross();
        updateDisplay();
      }
    }

    // If signal received from nRF24

    if (radio.available()) {
      radio.read(&data, sizeof(data));
      if (data == 44) {
        tick();
        score = score + scorePlus;
        updateDisplay();
      }
    }

    // If trigger is pushed

    if (digitalRead(trigger) == LOW) {
      Serial.write(dataBytes, sizeof(dataBytes));
      for (int i = 0; i <= 200; i++) {
        soundFX(100.0, 30.0); // ray gun
      }
      delay(500);
    }
  }
}

bool askUI (char char1[], char char2[], int wait, int configurable) {
  display.clearDisplay();
  display.setCursor(0, 0);
  display.println(char1);
  display.println(char2);
  display.display();
  timeStart = millis();
  timeVal = 0;
  while (timeVal < wait && c == false) {
    timeVal = millis() - timeStart;
    if (digitalRead(trigger) == LOW) {
      configurable = true;
    }
    else {configurable = false;}
  }
  return configurable;
}




void configuration() {
  
  // Configuration Weapon

  if (ID == 1) {
    c = askUI("Modifier", "config?", 3000, c);
    if (c == true) {
      c1 = askUI("Prochaine", "?", 3000, c1);
      if (c1 == true) {
        weaponNb = confUI(2, weaponNb, "Nb d'armes", "armes", false, weaponNbDef);
        gameTime = confUI(1, gameTime, "Temps", "min", false, gameTimeDef);
        scorePlus = confUI(10, scorePlus, "Score +", "pts", false, scorePlusDef);
        scoreMinus = confUI(10, scoreMinus, "Score -", "pts", false, scoreMinusDef);
        sendConf(20);
        display.clearDisplay();
        display.setCursor(0, 0);
        display.println("Envoi");
        display.display();
        sendConf(weaponNb);
        sendConf(gameTime);
        sendConf(scorePlus);
        sendConf(scoreMinus);
        radio.startListening();
        waitConfirmation();
      }
      if (c1 == false) {
        c2 = askUI("Defaut", "?", 3000, c2);
      }
      if (c2 == true) {
        weaponNb = confUI(2, weaponNb, "Nb d'armes", "armes", true, weaponNbDef);
        gameTime = confUI(1, gameTime, "Temps", "min", true, gameTimeDef);
        scorePlus = confUI(10, scorePlus, "Score +", "pts", true, scorePlusDef);
        scoreMinus = confUI(10, scoreMinus, "Score -", "pts", true, scoreMinusDef);
        sendConf(22);
        display.clearDisplay();
        display.setCursor(0, 0);
        display.println("En attente");
        display.display();
        sendConf(weaponNb);
        sendConf(gameTime);
        sendConf(scorePlus);
        sendConf(scoreMinus);
        radio.startListening();
        c1 = true;
        waitConfirmation();
      }
    }
    else if (c == false || c1 == false) {
      display.clearDisplay();
      display.setCursor(0, 0);
      display.println("Configure");
      display.display();
      delay(2000);
      EEPROM.get(weaponNbDef, weaponNb);
      EEPROM.get(gameTimeDef, gameTime);
      EEPROM.get(scorePlusDef, scorePlus);;
      EEPROM.get(scoreMinusDef, scoreMinus);
      //weaponNb = 2;
      //gameTime = 1;
      //scorePlus = 10;
      //scoreMinus = 10;
      display.clearDisplay();
      display.setCursor(0, 0);
      display.println("Envoi");
      display.display();
      sendConf(21);
      waitConfirmation();
    }
  }

  // Generic Weapon

  else {
    while (c == false) {
      display.clearDisplay();
      display.setCursor(0, 0);
      display.println("En attente");
      display.print("de conf");
      display.display();
      while (!radio.available()) {}
      radio.read(&data, sizeof(data));
      if (data == 20 || data == 21 || data == 22) {
        if (data == 21) {
          display.clearDisplay();
          display.setCursor(0, 0);
          display.println("Par defaut");
          display.display();
          EEPROM.get(weaponNbDef, weaponNb);                      // A changer !!!!!!!!!!!!!!!!!!!!!!!!!!!!!!!!!!!
          EEPROM.get(gameTimeDef, gameTime);
          EEPROM.get(scorePlusDef, scorePlus);;
          EEPROM.get(scoreMinusDef, scoreMinus);
          //weaponNb = 2;
          //gameTime = 1;
          //scorePlus = 10;
          //scoreMinus = 10;
          display.clearDisplay();
          display.setCursor(0, 0);
          display.println("Configure !");
          display.display();
        }
        else if (data == 20) {
          display.clearDisplay();
          display.setCursor(0, 0);
          display.println("Provisoire");
          display.display();
          waitData(weaponNb, false, weaponNbDef);
          waitData(gameTime, false, gameTimeDef);
          waitData(scorePlus, false, scorePlusDef);
          waitData(scoreMinus, false, scoreMinusDef);
          display.clearDisplay();
          display.setCursor(0, 0);
          display.println("Configure !");
          display.display();
        }
        else if (data == 22) {
          display.clearDisplay();
          display.setCursor(0, 0);
          display.println("Definitive");
          display.display();
          waitData(weaponNb, true, weaponNbDef);
          waitData(gameTime, true, gameTimeDef);
          waitData(scorePlus, true, scorePlusDef);
          waitData(scoreMinus, true, scoreMinusDef);
          display.clearDisplay();
          display.setCursor(0, 0);
          display.println("Configure !");
          display.display();

        }
        radio.openWritingPipe(addresses[0]);
        delayTime = (ID - 1) * 250;
        delay(delayTime);
        radio.stopListening();
        data = 22 + ID;
        radio.write(&data, sizeof(data));
        radio.startListening();
        c = true;
      }
    }
  }
}

void waitConfirmation() {
  for (int f = 24; f <= weaponNb + 22; f++) {
    display.clearDisplay();
    display.setCursor(0, 0);
    display.println("En attente");
    display.display();
    timeStart = millis();
    timeVal = 0;
    while (!radio.available() && timeVal < 2000) {
      timeVal = millis() - timeStart;
    }
    radio.read(&data, sizeof(data));
    timeVal = millis() - timeStart;
    if (data != 24 || timeVal > 2000) {
      display.clearDisplay();
      display.setCursor(0, 0);
      display.println("Redemarrer");
      display.display();
      while (1 == 1) {}
    }
  }
}
byte confUI(int def, byte val, char char1[], char char2[], bool EEPR, int valDef) {
  val = def;
  display.clearDisplay();
  display.setCursor(0, 0);
  display.println(char1);
  display.setCursor(0, 16);
  display.println(val);
  display.setCursor(64, 16);
  display.println(char2);
  display.display();
  delay(350);
  timeStart = millis();
  timeVal = millis() - timeStart;
  while (timeVal < 2000) {
    timeVal = millis() - timeStart;
    if (digitalRead(trigger) == LOW) {
      val++;
      delay(250);
      timeStart = millis();
      display.clearDisplay();
      display.setCursor(0, 0);
      display.println(char1);
      display.setCursor(0, 16);
      display.println(val);
      display.setCursor(64, 16);
      display.println(char2);
      display.display();
    }
  }
  if (EEPR == true) {
    EEPROM.write(valDef, val);
  }
  return val;
}

void sendConf(int d) {
  radio.stopListening();
  for (int h = 1; h <= (weaponNb - 1); h++) {
    data = d;
    radio.openWritingPipe(addresses[h]);
    radio.write(&data, sizeof(data));
  }
  radio.startListening();
}

void waitData(int val, bool EEPR, int valDef) {
  timeStart = millis();
  timeVal = millis() - timeStart;
  while (!radio.available() && timeVal < 260) {
    timeVal = millis() - timeStart;
  }
  if (timeVal > 260) {
    display.clearDisplay();
    display.setCursor(0, 0);
    display.println("Redemarrer");
    display.display();
    while (1 == 1) {}
  }
  radio.read(&data, sizeof(data));
  val = data;
  if (EEPR == true) {
    EEPROM.put(valDef, data);
  }
}









void ending() {
  // Calculating score positions

  int scores[weaponNb + 1];
  int sortScores[weaponNb + 1];
  int pos[weaponNb + 1];
  scores[0] = -9999999;

  if (ID == 1) {
    pos[ID] = 1234;
    // receiving data

    for (int f = 2; f <= weaponNb; f++) {
      radio.startListening();
      timeStart = millis();
      timeVal = 0;
      while (!radio.available() && timeVal < 2000) {
        timeVal = millis() - timeStart;
        display.clearDisplay();
        display.setCursor(0, 0);
        display.println("attente");
        display.display();
      }
      radio.read(&data, sizeof(data));
      scores[f] = data;
      timeVal = millis() - timeStart;
      if (timeVal > 2000) {
        display.clearDisplay();
        display.setCursor(0, 0);
        display.println("Redemarrer");
        display.display();
        while (1 == 1) {}
      }
    }
    scores[1] = score;

    // Calculations

    for (int i = 0; i <= weaponNb; i++) {
      sortScores[i] = scores[i];
    }
    sortArrayReverse(sortScores, weaponNb + 1);
    for (int a = 0; a <= weaponNb; a++) {
      for (int b = 0; b <= weaponNb; b++) {
        if (scores[a] == sortScores[b]) {
          pos[a] = b;
        }
      }
    }


    // sending position

    radio.stopListening();
    for (int f = 1; f <= (weaponNb); f++) {
      data = pos[f];;
      radio.openWritingPipe(addresses[f - 1]);
      radio.write(&data, sizeof(data));
    }
  }

  else {
    pos[ID] = 1234;
    delayTime = (ID - 1) * 250;
    delay(delayTime);
    radio.stopListening();
    data = score;
    radio.openWritingPipe(addresses[0]);
    radio.write(&data, sizeof(data));
    radio.startListening();
    while (!radio.available()) {}
    radio.read(&data, sizeof(data));
    pos[ID] = data;
  }

  display.setTextSize(2);
  display.clearDisplay();
  display.setCursor(0, 0);
  display.println("Vous etes");
  display.print(pos[ID]);
  display.print("e");
  display.display();
  while (1 == 1) {}
}










void playTone(int tone, int duration) {
  for (long i = 0; i < duration * 1000L; i += tone * 2) {
    digitalWrite(speakerPin, HIGH);
    delayMicroseconds(tone);
    digitalWrite(speakerPin, LOW);
    delayMicroseconds(tone);
  }
}

void playNote(char note, int duration) {
  char names[] = { 'c', 'd', 'e', 'f', 'g', 'x', 'a', 'z', 'b', 'C', 'y', 'D', 'w', 'E', 'F', 'q', 'G', 'i' };
  // c=C4, C = C5. These values have been tuned.
  int tones[] = { 1898, 1690, 1500, 1420, 1265, 1194, 1126, 1063, 1001, 947, 893, 843, 795, 749, 710, 668, 630, 594 };

  // play the tone corresponding to the note name
  for (int i = 0; i < 18; i++) {
    if (names[i] == note) {
      playTone(tones[i], duration);
    }
  }
}

void returnStart() {
  display.clearDisplay();
  display.setTextSize(2);
  display.setCursor(0, 0);
  display.println("Retour au");
  display.print("pt depart");
  display.display();
  for (int i = 0; i < length; i++) {
    if (notes[i] == ' ') {
      delay(beats[i] * tempo); // rest
    } else {
      playNote(notes[i], beats[i] * tempo);
    }

    // pause between notes
    delay(tempo / 2);
  }
}

void gameEnd() {
  playing = false;
}

void updateDisplay() {
  display.clearDisplay();
  display.setCursor(0, 0);
  display.println(score);
  display.display();
}

void soundFX(float amplitude, float period) {
  int uDelay = 2 + amplitude + amplitude * sin(millis() / period);
  for (int i = 0; i < 5; i++) {
    digitalWrite(piezo, HIGH);
    delayMicroseconds(uDelay);
    digitalWrite(piezo, LOW);
    delayMicroseconds(uDelay);
  }
}

void cross() {
  display.clearDisplay();
  display.drawBitmap(0, 0, crossed, 128, 32, WHITE);
  display.display();
  delay(500);
}

void tick() {
  display.clearDisplay();
  display.drawBitmap(0, 0, ticked, 128, 32, WHITE);
  display.display();
  delay(500);
}
